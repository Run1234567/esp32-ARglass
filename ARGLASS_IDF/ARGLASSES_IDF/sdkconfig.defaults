## ARGLASS_IDF/ARGLASSES_IDF/sdkconfig.defaults
```kconfig
# ESP-IDF SDK 默认配置覆盖
# 此文件覆盖 ESP-IDF 的默认 sdkconfig 值
# PlatformIO 编译时会自动合并此文件的配置

# CPU 频率
CONFIG_ESP_DEFAULT_CPU_FREQ_MHZ_240=y
CONFIG_ESP_DEFAULT_CPU_FREQ_MHZ=240

# PSRAM (外部 SPI RAM) 配置
CONFIG_SPIRAM=y
CONFIG_SPIRAM_MODE_OCT=y
CONFIG_SPIRAM_SPEED_80M=y
CONFIG_SPIRAM_USE_MALLOC=y
CONFIG_SPIRAM_FETCH_INSTRUCTIONS=y
CONFIG_SPIRAM_RODATA=y

# FreeRTOS 配置
CONFIG_FREERTOS_HZ=1000
CONFIG_ESP_MAIN_TASK_STACK_SIZE=8192

# WiFi 配置
CONFIG_ESP_WIFI_RX_BA_WIN=16

# TCP/IP 配置
CONFIG_LWIP_TCP_SND_BUF_DEFAULT=8192
CONFIG_LWIP_TCP_WND_DEFAULT=8192

# 控制台输出
CONFIG_ESP_CONSOLE_USB_SERIAL_JTAG=y

# 分区表
CONFIG_PARTITION_TABLE_CUSTOM=y
CONFIG_PARTITION_TABLE_CUSTOM_FILENAME="partitions.csv"
CONFIG_PARTITION_TABLE_FILENAME="partitions.csv"

# WebSocket 传输
CONFIG_WS_TRANSPORT=y
```

## ESP32_BlueYa/ESP32_Blue_GuiJiQiu/sdkconfig.defaults
```kconfig
# 启用蓝牙 + NimBLE 协议栈
CONFIG_BT_ENABLED=y
CONFIG_BT_NIMBLE_ENABLED=y

# Flash 大小匹配实际硬件
CONFIG_ESPTOOLPY_FLASHSIZE_2MB=y

# I2C 引脚配置
CONFIG_I2C_MASTER_SCL=8
CONFIG_I2C_MASTER_SDA=9
```

## ESP32_BlueYa/ESP32_Blue_Imu/sdkconfig.defaults
```kconfig
# Enable Bluetooth and NimBLE
CONFIG_BT_ENABLED=y
CONFIG_BT_NIMBLE_ENABLED=y
CONFIG_BT_NIMBLE_MAX_CONNECTIONS=3
CONFIG_BT_NIMBLE_MAX_SOCKS=3
```

## esp32_LVGL/esp32_LVGL/sdkconfig.defaults
```kconfig
CONFIG_ESP_CONSOLE_USB_SERIAL_JTAG=y
CONFIG_ESP_SYSTEM_EVENT_TASK_STACK_SIZE=8192

# 减少 WiFi 缓冲区，为 BLE + LVGL 节省内存
CONFIG_ESP_WIFI_STATIC_RX_BUFFER_NUM=5
CONFIG_ESP_WIFI_DYNAMIC_RX_BUFFER_NUM=8
CONFIG_ESP_WIFI_DYNAMIC_TX_BUFFER_NUM=8

# LVGL 启用 Montserrat 48 字体
CONFIG_LV_FONT_MONTSERRAT_48=y
# LVGL 使用系统 malloc（利用 PSRAM 的 8MB 内存，彻底解决 OOM 问题）
CONFIG_LV_MEM_CUSTOM=y
# 抑制 I2C 废弃警告
CONFIG_I2C_SUPPRESS_DEPRECATE_WARN=y

# 启用 LEDC (PWM 马达控制)
CONFIG_SOC_LEDC_SUPPORTED=y

# 禁用编译器警告为错误（允许 C++ 隐式转换）
CONFIG_COMPILER_DISABLE_DEFAULT_WARNINGS=y

# 启用蓝牙
CONFIG_BT_ENABLED=y
CONFIG_BT_NIMBLE_ENABLED=y
CONFIG_BT_CONTROLLER_ENABLED=y

# 启用 PSRAM（你的代码大量使用 MALLOC_CAP_SPIRAM）
CONFIG_ESP32S3_SPIRAM_SUPPORT=y
CONFIG_SPIRAM=y
CONFIG_SPIRAM_MODE_OCT=y
CONFIG_SPIRAM_SPEED_80M=y
```
